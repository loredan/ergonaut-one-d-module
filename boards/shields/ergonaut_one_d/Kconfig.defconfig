## boards/shields/ergonaut_one_d/Kconfig.defconfig
```kconfig
if SHIELD_ERGONAUT_ONE_D_DONGLE

config ZMK_KEYBOARD_NAME
    default "Ergonaut One D"

config ZMK_SPLIT_ROLE_CENTRAL
    default y

config ZMK_SPLIT_BLE_CENTRAL_PERIPHERALS
    default 2

config BT_MAX_CONN
    default 7

config BT_MAX_PAIRED
    default 7

config ZMK_USB
    default y

endif

config ZMK_SPLIT
    default y
```

## boards/shields/ergonaut_one_d/Kconfig.shield
```kconfig
config SHIELD_ERGONAUT_ONE_D_DONGLE
    def_bool $(shields_list_contains,ergonaut_one_d_dongle)

config SHIELD_ERGONAUT_ONE_D_LEFT
    def_bool $(shields_list_contains,ergonaut_one_d_left)

config SHIELD_ERGONAUT_ONE_D_RIGHT
    def_bool $(shields_list_contains,ergonaut_one_d_right)
```
