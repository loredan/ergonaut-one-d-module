#include <dt-bindings/zmk/matrix_transform.h>
#include "ergonaut_one_d-layouts.dtsi"

/ {
    kscan_dongle: kscan0 {
        compatible = "zmk,kscan-gpio-direct";
        wakeup-source;
        input-gpios = <&gpio1 6 (GPIO_PULL_UP | GPIO_ACTIVE_LOW)>;
    };

    default_transform: keymap_transform0 {
        compatible = "zmk,matrix-transform";
        columns = <1>;
        rows = <1>;
        map = <RC(0,0)>;
    };
};

&ergonaut_one_d_physical_layout {
    transform = <&default_transform>;
    kscan = <&kscan_dongle>;
};
